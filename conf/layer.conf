## conf/layer.conf
```bitbake
# We have a conf and classes directory, add to BBPATH
BBPATH .= ":${LAYERDIR}"

# We have recipes-* directories, add to BBFILES
BBFILES += "${LAYERDIR}/recipes-*/*/*.bb \
            ${LAYERDIR}/recipes-*/*/*.bbappend"

BBFILE_COLLECTIONS += "meta-myir-st-tiny"
BBFILE_PATTERN_meta-myir-st-tiny = "^${LAYERDIR}/"
BBFILE_PRIORITY_meta-myir-st-tiny = "6"

EULA_FILE_ST_myir = "${LAYERDIR}/conf/eula/${MACHINE}"
#EULA_FILE_ST_myir = "${LAYERDIR}/conf/eula/myir-tiny"
EULA_FILE_ST_MD5SUM_myir = "8b505090fb679839cefbcc784afe8ce9"
LICENSE_PATH += "${LAYERDIR}/files/licenses"


#LAYERDEPENDS_meta-myir-st = "core"
#LAYERSERIES_COMPAT_meta-myir-st = "thud"

# This should only be incremented on significant changes that will
# cause compatibility issues with other layers
LAYERVERSION_meta-myir-st-tiny = "1"
LAYERSERIES_COMPAT_meta-myir-st-tiny = "dunfell"

# for optee-os-stm32mp dependency
LAYERDEPENDS_meta-myir-st-tiny = "core openembedded-layer meta-python"
```
